## config/boards/bloowper_macropad_v1/Kconfig.defconfig
```kconfig
if SHIELD_MACROPAD_V1

config ZMK_KEYBOARD_NAME
    default "my macropad v1"

endif
```

## config/boards/macropad_v1/Kconfig.defconfig
```kconfig
if SHIELD_MACROPAD_V1

config ZMK_KEYBOARD_NAME
    default "macropad_v1"

endif
```
